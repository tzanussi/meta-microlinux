## conf/distro/poky-micro.conf
```bitbake
require conf/distro/poky-tiny.conf

DISTRO = "poky-micro"
DISTRO_NAME = "microLinux"
DISTROOVERRIDES = "poky:poky-tiny:${DISTRO}"

PREFERRED_PROVIDER_virtual/kernel = "linux-yocto-micro"
PREFERRED_VERSION_linux-yocto-micro = "4.1%"
#PREFERRED_VERSION_linux-yocto-micro = "3.19%"
PREFERRED_VERSION_ethtool = "3.6%"

VIRTUAL-RUNTIME_init_manager = "sysvinit"
VIRTUAL-RUNTIME_initscripts = "initscripts"

TCLIBC = "uclibc"

BINUVERSION = "2.24.51.0.3"

DISTRO_FEATURES += "single-user"
#DISTRO_FEATURES += "xip"
#DISTRO_FEATURES += "tracing"
```

## conf/machine/minnowmax-64.conf
```bitbake
#@TYPE: Machine
#@NAME: minnowmax-64

#@DESCRIPTION: Machine configuration for minnowMAX 64-bit systems

PREFERRED_PROVIDER_virtual/kernel ?= "linux-yocto-micro"
PREFERRED_VERSION_linux-yocto-micro ?= "3.19%"
#PREFERRED_VERSION_linux-yocto-micro ?= "3.17%"
#PREFERRED_VERSION_linux-yocto-micro ?= "3.14%"
#PREFERRED_VERSION_linux-yocto-micro ?= "3.13%"
#PREFERRED_VERSION_linux-yocto-micro ?= "3.8%"

#DEFAULTTUNE ?= "corei7-64"
require conf/machine/include/tune-corei7.inc
require conf/machine/include/x86-base.inc

#Avoid pulling in GRUB
MACHINE_ESSENTIAL_EXTRA_RDEPENDS = ""

MACHINE_FEATURES = "efi usb pci"

SERIAL_CONSOLE = "115200 ttyS1"
#SERIAL_CONSOLES = "115200;ttyS0 115200;ttyS1"

USE_VT = "0"

EXTRA_IMAGEDEPENDS += "grub-efi"
```
